## conf/layer.conf
```bitbake
# We have a conf and classes directory, add to BBPATH
BBPATH .= ":${LAYERDIR}"

# We have recipes-* directories, add to BBFILES
BBFILES += "${LAYERDIR}/recipes-*/*/*.bb \
            ${LAYERDIR}/recipes-*/*/*.bbappend"

BBFILE_COLLECTIONS += "ibm-layer"
BBFILE_PATTERN_ibm-layer := "^${LAYERDIR}/"
LAYERSERIES_COMPAT_ibm-layer = "warrior zeus"

BBFILES_DYNAMIC += " \
    filesystems-layer:${LAYERDIR}/dynamic-layers/filesystems-layer/*/*/*.bb \
    filesystems-layer:${LAYERDIR}/dynamic-layers/filesystems-layer/*/*/*.bbappend \
"
```

## meta-mihawk/conf/layer.conf
```bitbake
# We have a conf and classes directory, add to BBPATH
BBPATH .= ":${LAYERDIR}"

# We have recipes-* directories, add to BBFILES
BBFILES += "${LAYERDIR}/recipes-*/*/*.bb \
            ${LAYERDIR}/recipes-*/*/*.bbappend"

BBFILE_COLLECTIONS += "mihawk-layer"
BBFILE_PATTERN_mihawk-layer := "^${LAYERDIR}/"
LAYERSERIES_COMPAT_mihawk-layer = "thud warrior"
```

## meta-swift/conf/layer.conf
```bitbake
# We have a conf and classes directory, add to BBPATH
BBPATH .= ":${LAYERDIR}"

# We have recipes-* directories, add to BBFILES
BBFILES += "${LAYERDIR}/recipes-*/*/*.bb \
            ${LAYERDIR}/recipes-*/*/*.bbappend"

BBFILE_COLLECTIONS += "swift-layer"
BBFILE_PATTERN_swift-layer = ""
LAYERSERIES_COMPAT_swift-layer = "thud"
```

## meta-witherspoon-2/conf/layer.conf
```bitbake
# We have a conf and classes directory, add to BBPATH
BBPATH .= ":${LAYERDIR}"

# We have recipes-* directories, add to BBFILES
BBFILES += "${LAYERDIR}/recipes-*/*/*.bb \
            ${LAYERDIR}/recipes-*/*/*.bbappend"

BBFILE_COLLECTIONS += "witherspoon-2-layer"
BBFILE_PATTERN_witherspoon-2-layer = ""
LAYERSERIES_COMPAT_witherspoon-2-layer = "thud"
```

## meta-witherspoon-2/conf/machine/witherspoon-2.conf
```bitbake
require conf/machine/witherspoon.conf

KERNEL_DEVICETREE = "${KMACHINE}-bmc-opp-witherspoon.dtb"
MRW_XML = "witherspoon.xml"

# 128MB flash size
FLASH_SIZE = "131072"
```

## meta-witherspoon/conf/distro/openbmc-witherspoon.conf
```bitbake
require conf/distro/openbmc-openpower.conf
require conf/distro/include/phosphor-tiny.inc
require conf/distro/include/openpower-mrw.inc
```

## meta-witherspoon/conf/machine/swift.conf
```bitbake
require conf/machine/witherspoon.conf

KERNEL_DEVICETREE = "${KMACHINE}-bmc-opp-swift.dtb"

# TODO Update once a Swift MRW is available
PHOSPHOR_MRW_LICENSE = "Apache-2.0"
PHOSPHOR_MRW_LIC_FILES_CHKSUM = "file://LICENSE;md5=e3fc50a88d0a364313df4b21ef20c29e"
PHOSPHOR_MRW_URI = "git://github.com/open-power/witherspoon-xml"
PHOSPHOR_MRW_REV = "e76c2fc5aeb512a0eb33438c239746de5b629885"

# 128MB flash size
FLASH_SIZE = "131072"
```

## meta-witherspoon/conf/machine/witherspoon-128.conf
```bitbake
MACHINEOVERRIDES =. "witherspoon:"
require conf/machine/witherspoon.conf

MRW_XML = "witherspoon.xml"

# 128MB flash size
FLASH_SIZE = "131072"

# 32MB read-write filesystem
FLASH_UBI_RWFS_SIZE ?= "32768"
FLASH_UBI_RWFS_TXT_SIZE ?= "32MiB"
BMC_RW_SIZE = "0x2000000"
```
